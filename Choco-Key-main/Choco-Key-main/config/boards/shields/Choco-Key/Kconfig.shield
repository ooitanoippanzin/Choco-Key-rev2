## Choco-Key-main/Choco-Key-main/config/boards/shields/Choco-Key/Kconfig.shield
```kconfig
config SHIELD_CHOCO-KEY_R
    def_bool $(shields_list_contains,Choco-Key_R)

config SHIELD_CHOCO-KEY_L
    def_bool $(shields_list_contains,Choco-Key_L)
```

## config/boards/shields/Choco-Key/Kconfig.defconfig
```kconfig
if SHIELD_CHOCO-KEY_R

config ZMK_KEYBOARD_NAME
    default "Choco-Key_R"

config ZMK_SPLIT
    default y

config ZMK_SPLIT_ROLE_CENTRAL
    default y

endif

if SHIELD_CHOCO-KEY_L

config ZMK_KEYBOARD_NAME
    default "Choco-Key_L"

config ZMK_SPLIT
    default y

endif
```

## config/boards/shields/Choco-Key/Kconfig.shield
```kconfig
config SHIELD_CHOCO-KEY_R
    def_bool $(shields_list_contains,Choco-Key_R)

config SHIELD_CHOCO-KEY_R
    def_bool $(shields_list_contains,Choco-Key_L)
```
